## CMakeLists.txt
```
#
# Copyright (c) 2018 Nordic Semiconductor
#
# SPDX-License-Identifier: LicenseRef-Nordic-5-Clause
#
cmake_minimum_required(VERSION 3.20.0)

find_package(Zephyr REQUIRED HINTS $ENV{ZEPHYR_BASE})
project(peripheral_lbs_cpp LANGUAGES CXX)

# NORDIC SDK APP START

# Main application
target_sources(app PRIVATE
  src/main.cpp
  src/application.cpp
)

# Hardware module
target_sources(app PRIVATE
  src/hardware/led_controller.cpp
  src/hardware/button_controller.cpp
)

# Bluetooth module
target_sources(app PRIVATE
  src/bluetooth/advertising_manager.cpp
  src/bluetooth/connection_manager.cpp
  src/bluetooth/security_manager.cpp
)

# Services module
target_sources(app PRIVATE
  src/services/lbs_service_handler.cpp
)

# Include directories
target_include_directories(app PRIVATE
  src
)

# Enable C++ support
set_target_properties(app PROPERTIES
  CXX_STANDARD 17
  CXX_STANDARD_REQUIRED ON
)

# NORDIC SDK APP END
```

## Kconfig
```
#
# Copyright (c) 2018 Nordic Semiconductor
#
# SPDX-License-Identifier: LicenseRef-Nordic-5-Clause
#

source "Kconfig.zephyr"

menu "Nordic LED-Button BLE GATT service sample (C++)"

config BT_LBS_SECURITY_ENABLED
	bool "Enable security"
	default y
	select BT_SMP
	select BT_SETTINGS
	select FLASH
	select FLASH_PAGE_LAYOUT
	select FLASH_MAP
	select ZMS if (SOC_FLASH_NRF_RRAM || SOC_FLASH_NRF_MRAM)
	select NVS if !(SOC_FLASH_NRF_RRAM || SOC_FLASH_NRF_MRAM)
	select SETTINGS
	help
	  "Enable BLE security for the LED-Button service"

endmenu
```

## sample.yaml
```
sample:
  description: Bluetooth Low Energy LED Button service sample (C++)
  name: Bluetooth LE LED Button service (C++)
tests:
  sample.bluetooth.peripheral_lbs_cpp:
    sysbuild: true
    integration_platforms:
      - nrf52dk/nrf52832
      - nrf52840dk/nrf52840
      - nrf5340dk/nrf5340/cpuapp
      - nrf5340dk/nrf5340/cpuapp/ns
      - thingy53/nrf5340/cpuapp
      - nrf54l15dk/nrf54l05/cpuapp
      - nrf54l15dk/nrf54l10/cpuapp
      - nrf54l15dk/nrf54l15/cpuapp
      - nrf54l15dk/nrf54l15/cpuapp/ns
      - nrf54lm20dk/nrf54lm20a/cpuapp
      - nrf54lm20dk/nrf54lm20a/cpuapp/ns
      - nrf54lv10dk/nrf54lv10a/cpuapp
      - nrf54lv10dk/nrf54lv10a/cpuapp/ns
      - nrf54h20dk/nrf54h20/cpuapp
    platform_allow:
      - nrf52dk/nrf52832
      - nrf52840dk/nrf52840
      - nrf5340dk/nrf5340/cpuapp
      - nrf5340dk/nrf5340/cpuapp/ns
      - thingy53/nrf5340/cpuapp
      - nrf54l15dk/nrf54l05/cpuapp
      - nrf54l15dk/nrf54l10/cpuapp
      - nrf54l15dk/nrf54l15/cpuapp
      - nrf54l15dk/nrf54l15/cpuapp/ns
      - nrf54lm20dk/nrf54lm20a/cpuapp
      - nrf54lm20dk/nrf54lm20a/cpuapp/ns
      - nrf54lv10dk/nrf54lv10a/cpuapp
      - nrf54lv10dk/nrf54lv10a/cpuapp/ns
      - nrf54h20dk/nrf54h20/cpuapp
    tags:
      - bluetooth
      - ci_build
      - sysbuild
      - cpp
    harness: console
    harness_config:
      type: multi_line
      ordered: true
      regex:
        - "Starting Bluetooth Peripheral LBS sample \\(C\\+\\+\\)"
        - "Bluetooth initialized"
        - "Advertising successfully started"
    timeout: 15
```

## prj.conf
```kconfig
#
# Copyright (c) 2018 Nordic Semiconductor
#
# SPDX-License-Identifier: LicenseRef-Nordic-5-Clause
#
CONFIG_NCS_SAMPLES_DEFAULTS=y

CONFIG_BT=y
CONFIG_BT_PERIPHERAL=y
CONFIG_BT_DEVICE_NAME="Nordic_LBS"

# Enable the LBS service
CONFIG_BT_LBS=y
CONFIG_BT_LBS_POLL_BUTTON=y
CONFIG_DK_LIBRARY=y

CONFIG_SYSTEM_WORKQUEUE_STACK_SIZE=2048

# Enable C++ support
CONFIG_CPP=y
CONFIG_STD_CPP17=y
CONFIG_REQUIRES_FULL_LIBCPP=y
```

## prj_minimal.conf
```kconfig
#
# Copyright (c) 2018 Nordic Semiconductor
#
# SPDX-License-Identifier: LicenseRef-Nordic-5-Clause
#

CONFIG_BT=y
CONFIG_BT_PERIPHERAL=y
CONFIG_BT_DEVICE_NAME="Nordic_LBS"

# Enable the LBS service
CONFIG_BT_LBS=y
CONFIG_BT_LBS_POLL_BUTTON=y
CONFIG_DK_LIBRARY=y

# Enable C++ support
CONFIG_CPP=y
CONFIG_STD_CPP17=y
```

## src/main.cpp
```c
/*
 * Copyright (c) 2018 Nordic Semiconductor ASA
 *
 * SPDX-License-Identifier: LicenseRef-Nordic-5-Clause
 */

#include "application.hpp"
#include "bluetooth/connection_manager.hpp"
#include "bluetooth/security_manager.hpp"

extern "C" {
#include <zephyr/sys/printk.h>
#include <zephyr/bluetooth/conn.h>
}

// Connection callbacks must be defined at file scope for BT_CONN_CB_DEFINE macro
namespace {

void on_connected(bt_conn* conn, uint8_t err) {
    nrf::bluetooth::ConnectionManager::onConnected(conn, err);
}

void on_disconnected(bt_conn* conn, uint8_t reason) {
    nrf::bluetooth::ConnectionManager::onDisconnected(conn, reason);
}

void on_recycled() {
    nrf::bluetooth::ConnectionManager::onRecycled();
}

#ifdef CONFIG_BT_LBS_SECURITY_ENABLED
void on_security_changed(bt_conn* conn, bt_security_t level, enum bt_security_err err) {
    nrf::bluetooth::SecurityManager::onSecurityChanged(conn, level, err);
}
#endif

} // anonymous namespace

// Register connection callbacks with Zephyr
BT_CONN_CB_DEFINE(conn_callbacks) = {
    .connected = on_connected,
    .disconnected = on_disconnected,
    .recycled = on_recycled,
#ifdef CONFIG_BT_LBS_SECURITY_ENABLED
    .security_changed = on_security_changed,
#endif
};

/**
 * @brief Application entry point
 */
int main() {
    nrf::Application app;

    auto result = app.initialize();
    if (!result) {
        printk("Application initialization failed (err %d)\n", result.errorCode());
        return 0;
    }

    app.run();
    return 0;
}
```

## src/application.cpp
```c
/*
 * Copyright (c) 2018 Nordic Semiconductor ASA
 *
 * SPDX-License-Identifier: LicenseRef-Nordic-5-Clause
 */

#include "application.hpp"
#include "config/constants.hpp"

extern "C" {
#include <zephyr/sys/printk.h>
#include <zephyr/kernel.h>
#include <zephyr/bluetooth/bluetooth.h>
#include <zephyr/settings/settings.h>
}

namespace nrf {

common::Result<> Application::initialize() {
    printk("Starting Bluetooth Peripheral LBS sample (C++ modular)\n");

    // Initialize hardware
    auto result = initializeHardware();
    if (!result) {
        printk("Hardware initialization failed\n");
        return result;
    }

    // Initialize Bluetooth
    result = initializeBluetooth();
    if (!result) {
        printk("Bluetooth initialization failed\n");
        return result;
    }

    // Initialize services
    result = initializeServices();
    if (!result) {
        printk("Services initialization failed\n");
        return result;
    }

    // Setup event handlers
    setupEventHandlers();

    // Start advertising
    advertising_manager_.start();

    printk("Application initialized successfully\n");
    return common::Result<>::ok();
}

void Application::run() {
    int blink_status = 0;

    while (true) {
        led_controller_.set(config::LedConfig::kRunStatus, (++blink_status) % 2);
        k_sleep(K_MSEC(config::TimingConfig::kRunLedBlinkIntervalMs));
    }
}

common::Result<> Application::initializeHardware() {
    // Initialize LEDs
    auto result = led_controller_.initialize();
    if (!result) {
        return result;
    }

    // Initialize buttons
    result = button_controller_.initialize();
    if (!result) {
        return result;
    }

    return common::Result<>::ok();
}

common::Result<> Application::initializeBluetooth() {
    // Initialize security manager first (registers callbacks before bt_enable)
    if constexpr (bluetooth::SecurityManager::isEnabled()) {
        auto result = security_manager_.initialize();
        if (!result) {
            return result;
        }
    }

    // Enable Bluetooth
    int err = bt_enable(nullptr);
    if (err) {
        printk("Bluetooth init failed (err %d)\n", err);
        return common::Result<>::error(err);
    }
    printk("Bluetooth initialized\n");

    // Load settings if enabled
    if (IS_ENABLED(CONFIG_SETTINGS)) {
        settings_load();
    }

    // Initialize advertising manager
    auto result = advertising_manager_.initialize();
    if (!result) {
        return result;
    }

    // Initialize connection manager
    result = connection_manager_.initialize(advertising_manager_);
    if (!result) {
        return result;
    }

    return common::Result<>::ok();
}

common::Result<> Application::initializeServices() {
    return lbs_service_.initialize(led_controller_, button_controller_);
}

void Application::setupEventHandlers() {
    // Setup button callback
    button_controller_.setCallback(
        [this](uint32_t button_state, uint32_t has_changed) {
            onButtonChanged(button_state, has_changed);
        });

    // Setup connection callback
    connection_manager_.setCallback(
        [this](bluetooth::ConnectionEvent event, bt_conn* conn) {
            onConnectionEvent(event, conn);
        });
}

void Application::onButtonChanged(uint32_t button_state, uint32_t has_changed) {
    if (has_changed & config::ButtonConfig::kUserMask) {
        bool pressed = (button_state & config::ButtonConfig::kUserMask) != 0;
        lbs_service_.sendButtonState(pressed);
    }
}

void Application::onConnectionEvent(bluetooth::ConnectionEvent event, bt_conn* conn) {
    switch (event) {
        case bluetooth::ConnectionEvent::Connected:
            led_controller_.turnOn(config::LedConfig::kConnectionStatus);
            break;

        case bluetooth::ConnectionEvent::Disconnected:
            led_controller_.turnOff(config::LedConfig::kConnectionStatus);
            break;

        case bluetooth::ConnectionEvent::Recycled:
            // Advertising restart is handled by connection manager
            break;
    }
}

} // namespace nrf
```

## src/application.hpp
```c
/*
 * Copyright (c) 2018 Nordic Semiconductor ASA
 *
 * SPDX-License-Identifier: LicenseRef-Nordic-5-Clause
 */

#pragma once

#include "common/result.hpp"
#include "hardware/led_controller.hpp"
#include "hardware/button_controller.hpp"
#include "bluetooth/advertising_manager.hpp"
#include "bluetooth/connection_manager.hpp"
#include "bluetooth/security_manager.hpp"
#include "services/lbs_service_handler.hpp"

namespace nrf {

/**
 * @brief Main application class for Bluetooth LBS sample
 * 
 * This class orchestrates all components of the BLE peripheral application,
 * including hardware controllers, Bluetooth managers, and GATT services.
 */
class Application {
public:
    Application() = default;
    ~Application() = default;

    // Delete copy operations
    Application(const Application&) = delete;
    Application& operator=(const Application&) = delete;

    /**
     * @brief Initialize all application components
     * @return Result indicating success or failure
     */
    [[nodiscard]] common::Result<> initialize();

    /**
     * @brief Run the main application loop
     * 
     * This function blocks and runs the main LED blink loop.
     * It does not return under normal operation.
     */
    void run();

private:
    /**
     * @brief Initialize hardware components (LEDs, buttons)
     * @return Result indicating success or failure
     */
    [[nodiscard]] common::Result<> initializeHardware();

    /**
     * @brief Initialize Bluetooth stack and managers
     * @return Result indicating success or failure
     */
    [[nodiscard]] common::Result<> initializeBluetooth();

    /**
     * @brief Initialize GATT services
     * @return Result indicating success or failure
     */
    [[nodiscard]] common::Result<> initializeServices();

    /**
     * @brief Setup event handlers and callbacks
     */
    void setupEventHandlers();

    /**
     * @brief Handle button state changes
     * @param button_state Current button state
     * @param has_changed Bitmask of changed buttons
     */
    void onButtonChanged(uint32_t button_state, uint32_t has_changed);

    /**
     * @brief Handle connection events
     * @param event Connection event type
     * @param conn Connection object (may be null)
     */
    void onConnectionEvent(bluetooth::ConnectionEvent event, bt_conn* conn);

    // Component instances
    hardware::LedController led_controller_;
    hardware::ButtonController button_controller_;
    bluetooth::AdvertisingManager advertising_manager_;
    bluetooth::ConnectionManager connection_manager_;
    bluetooth::SecurityManager security_manager_;
    services::LbsServiceHandler lbs_service_;
};

} // namespace nrf
```
